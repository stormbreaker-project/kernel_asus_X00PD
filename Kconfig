## Kconfig
```kconfig
menu "Asus X00P platform"
	depends on ARCH_MSM8937

config MACH_ASUS_X00P
	bool "Asus X00P"
	depends on ARCH_MSM8937
	help
	  Support for Asus X00P

source "techpack/x00p/fingerprint/Kconfig"
source "techpack/x00p/touchscreen/Kconfig"

endmenu
```

## fingerprint/Kconfig
```kconfig
menu "Fingerprint"

source "techpack/x00p/fingerprint/leadcore/Kconfig"
source "techpack/x00p/fingerprint/microarray/Kconfig"

endmenu
```

## touchscreen/Kconfig
```kconfig
menu "Touchscreen"
	depends on INPUT_TOUCHSCREEN

source "techpack/x00p/touchscreen/HX852xES/Kconfig"

endmenu
```
